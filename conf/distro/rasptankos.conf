## conf/distro/rasptankos.conf
```bitbake
DISTRO = "rasptankos"
DISTRO_NAME = "RaspTankOS (Linux Distribution for Adeept RaspTank Robot)"
DISTRO_VERSION = "1.0"
DISTRO_CODENAME = "dunfell"

# distro features
DISTRO_FEATURES_append = " x11 fbdev directfb opengl"
DISTRO_FEATURES_remove = " wayland vulkan"

# enable camera and pihat
ENABLE_I2C = "1"
KERNEL_MODULE_AUTOLOAD_rpi += " i2c-dev i2c-bcm2708"
VIDEO_CAMERA = "1"
```

## conf/layer.conf
```bitbake
# We have a conf and classes directory, add to BBPATH
BBPATH .= ":${LAYERDIR}"

# We have recipes-* directories, add to BBFILES
BBFILES += "${LAYERDIR}/recipes-*/*/*.bb \
            ${LAYERDIR}/recipes-*/*/*.bbappend"

BBFILE_COLLECTIONS += "meta-rasptank"
BBFILE_PATTERN_meta-rasptank = "^${LAYERDIR}/"
BBFILE_PRIORITY_meta-rasptank = "6"

LAYERDEPENDS_meta-rasptank = "core"
LAYERSERIES_COMPAT_meta-rasptank = "dunfell"
```
